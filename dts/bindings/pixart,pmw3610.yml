## dts/bindings/pixart,pmw3610.yml
```yaml
description: |
  Sensor driver for the pixart PMW3610 mouse sensor 

compatible: "pixart,pmw3610"

include: spi-device.yaml

properties:
  irq-gpios:
    type: phandle-array
    required: true
  cpi:
    type: int
    default: 600
    description: "CPI value (Range: 200 - 3200, Step: 200)"
  swap-xy:
    type: boolean
  invert-x:
    type: boolean
  invert-y:
    type: boolean
  evt-type:
    type: int
    required: true
  x-input-code:
    type: int
    required: true
  y-input-code:
    type: int
    required: true
  force-awake:
    type: boolean
  force-awake-4ms-mode:
    type: boolean
  pointer-acceleration:
    type: boolean
    description: Enable same-frame pointer acceleration for this sensor instance
  pointer-acceleration-base-gain-milli:
    type: int
    default: 1000
    description: Low-speed gain in thousandths
  pointer-acceleration-takeoff-speed:
    type: int
    default: 16
    description: Normalized vector speed where the gain ramp starts
  pointer-acceleration-full-speed:
    type: int
    default: 80
    description: Normalized vector speed where the output-speed slope reaches maximum gain
  pointer-acceleration-max-gain-milli:
    type: int
    default: 2000
    description: Maximum output-speed slope and asymptotic multiplier in thousandths
  pointer-acceleration-reference-interval-ms:
    type: int
    default: 8
    description: Sensor report interval used to normalize delayed frames
  pointer-acceleration-idle-reset-ms:
    type: int
    default: 60
    description: Idle time that clears fractional remainder state
  pointer-acceleration-precision-mode:
    type: boolean
    description: Enable a lower fixed gain that smoothly rejoins the standard curve
  pointer-acceleration-precision-gain-milli:
    type: int
    default: 500
    description: Precision-region gain in thousandths
  pointer-acceleration-precision-speed:
    type: int
    default: 16
    description: Highest normalized vector speed that uses only the precision gain
  pointer-acceleration-scroll-layer:
    type: int
    default: 2
    description: Layer on which acceleration is bypassed for raw scrolling
  pointer-acceleration-gesture-layer:
    type: int
    default: 3
    description: Layer on which acceleration is bypassed for raw gestures
  pointer-acceleration-gesture-layer-2:
    type: int
    description: |
      Optional second layer on which acceleration is bypassed for raw gestures.
      When omitted, it defaults to pointer-acceleration-gesture-layer.
```
